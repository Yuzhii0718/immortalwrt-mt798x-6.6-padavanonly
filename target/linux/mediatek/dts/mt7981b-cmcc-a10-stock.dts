// SPDX-License-Identifier: GPL-2.0-or-later OR MIT

/dts-v1/;
#include "mt7981b-cmcc-a10.dtsi"

/ {
	model = "CMCC A10 (stock layout)";
	compatible = "cmcc,a10-stock", "mediatek,mt7981";
};

&partitions {
	partition@580000 {
		label = "ubi";
		reg = <0x580000 0x7000000>;
	};
};

&spi_nand {
	mediatek,nmbm;
	mediatek,bmt-max-ratio = <1>;
	mediatek,bmt-max-reserved-blocks = <64>;
};
