// SPDX-License-Identifier: GPL-2.0-or-later OR MIT

/dts-v1/;
#include "mt7981b-cmcc-a10.dtsi"

/ {
	model = "CMCC A10 (dual-ubi layout)";
	compatible = "cmcc,a10-dual-ubi", "mediatek,mt7981";
};

&partitions {
	partition@580000 {
		label = "ubi";
		reg = <0x580000 0x3800000>;
	};

	partition@3c00000 {
		label = "ubi2";
		reg = <0x3d80000 0x3800000>;
	};
};
